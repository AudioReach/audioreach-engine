## Kconfig
```kconfig
mainmenu "AudioReach Engine $(MAJOR_VERSION).$(MINOR_VERSION)-$(PATCHLEVEL) Configuration"
rsource "arch/Kconfig"
rsource "modules/Kconfig"
rsource "fwk/Kconfig"
rsource "fwk/spf/modules/Kconfig"
rsource "fwk/spf/containers/Kconfig"
rsource "fwk/spf/amdb/Kconfig"
rsource "fwk/platform/modules/Kconfig"
rsource "fwk/platform/posal/Kconfig"
rsource "fwk/spf/apm/Kconfig"
```

## arch/Kconfig
```kconfig
source arch/hexagon/Kconfig
source arch/linux/Kconfig

config PROC_DOMAIN
    string "Target Processor Domain ID for ARE modules"
    default "APPS"
    help
      Specify the target processor domain ID for the module. This valus is
      used by H2XML parser to indicate the intended processor domain for
      module execution in the generated module XML's.
      Options: ADSP, MDSP, APPS, SDSP, CDSP, CC_DSP, GDSP_0, GDSP_1, APPS_2
```

## arch/hexagon/Kconfig
```kconfig
menuconfig ARCH_HEXAGON
        bool "Hexagon Architecture"
	help
          Say yes if you need Hexagon Architecture support

if ARCH_HEXAGON

config HEXAGON_TOOLS_ROOT
	string "Path to Hexagon llvm tools"
	help
	 Absolute Path to Hexagon tools

config HEXAGON_SDK_ROOT
	string "Path to Hexagon SDK root"
	help
	 Absolute Path to Hexagon SDK root

endif
```

## arch/linux/Kconfig
```kconfig
menuconfig ARCH_LINUX
    bool "Linux Architecture"
    help
        Say yes if you need Linxu Architecture support
```

## arch/zephyr/Kconfig
```kconfig
menuconfig ARCH_ZEPHYR
    bool "Zephyr Architecture"
    help
        Say yes if you need Zephyr Architecture support

endif
```

## fwk/platform/Kconfig
```kconfig
menu "Platform"

config DISABLE_PLATFORM
        bool "Disable compiling platform."
        default y if ARCH_LINUX || ARCH_HEXAGON
        default y
        help
          Select y to disable platform compilation,
          say n to compile platform.
          Defaults to 'y' for Linux and Hexagon architectures.

endmenu
```

## fwk/platform/posal/Kconfig
```kconfig
menu "POSAL"

config COMPILE_POSAL
        bool "Compile POSAL source files."
        default n if ARCH_HEXAGON
        default y
        help
           Select y to compile posal source files,
           say n to skip posal source files compilation.

config DLS_DATA_LOGGING
        bool "Enable Data Logging using Data Logging Service (DLS)."
        default y
        help
           Enable Data Logging using Data Logging Service (DLS). DLS service is used on
           platform where DIAG is not supported.

config POSAL_MMAP_NO_MMU
        bool "Identity PA==VA shared memory mapping (no mmap required)"
        default n
        help
           Enable on targets where physical and virtual address spaces are
           identical for shared memory regions. When set, mmap() is skipped
           and the physical address is used directly as the virtual pointer.
           Applicable on targets such as NXP i.MX8 ADSP running Zephyr.

endmenu
```

## fwk/spf/amdb/Kconfig
```kconfig
menu "Audio Module Database (AMDB)"

config DYNAMIC_LOADING
        bool "Dynamic loading support"
        default n
        help
          Enable dynamic loading of audio modules at runtime via dlopen.
 
          When disabled, modules are compiled and linked statically
          regardless of their individual dynamic loading configuration.

endmenu
```

## fwk/spf/apm/Kconfig
```kconfig
menu "APM"

config CONFIG_APM_MULTI_CLIENT
        bool "Enable Multi Client Library"
        default n

endmenu
```

## fwk/spf/containers/Kconfig
```kconfig
menu "Containers"

config WR_SH_MEM_EP
        bool "Enable Write Share Memory Endpoint"
        default y

config RD_SH_MEM_EP
        bool "Enable Read Share Memory Endpoint"
        default y

config PLACEHOLDER_ENC_DEC
        tristate "Enable PLACEHOLDER Library"
        default n

config SPECIAL_TOPOLOGY
        bool "Enable Special Topology"
        default n
        help
            Enable compilation of special topology components (spl_topo).

config SPL_CNTR
        bool "Enable Special Container"
        default n
        help
            Enable the Special Container module. When disabled, a stub
            implementation is compiled to maintain API compatibility.

config SPL_CNTR_EXT
        bool "Enable Special Container Extensions"
        depends on SPL_CNTR
        default y
        help
            Enable compilation of Special Container extension modules.
            This includes framework extensions for processing, synchronization,
            and voice delivery.
endmenu
```

## fwk/spf/modules/Kconfig
```kconfig
menu "Signal Processing Framework Modules"

config DATA_LOGGING
        tristate "Enable DATA_LOGGING Library"
        default y

config LATENCY
        tristate "Enable LATENCY Library"
        default y

config SYNC
        tristate "Enable SYNC Library"
        default y

config SPR
        tristate "Enable SPR Library"
        default y

config SPLITTER
        tristate "Enable SPLITTER Library"
        default y

config DATA_MARKER
        tristate "Enable DATA_MARKER Library"
        default y

config PRIORITY_SYNC
        tristate "Enable PRIORITY_SYNC Library"
        default y

config MUX_DEMUX
        tristate "Enable MUX_DEMUX Library"
        default y

config SISO_RAT
        tristate "Enable SISO_RAT Library"
        default y

config SH_MEM_PULL_MODE
        tristate "Enable SH_MEM_PULL_MODE Library"
        default y

config SH_MEM_PUSH_MODE
        tristate "Enable SH_MEM_PUSH_MODE Library"
        default y

config IRM
        bool "Enable Integrated Resource Monitor (IRM)"
        default y
        help
            Enable the Integrated Resource Monitor module for tracking and
            managing system resources. The IRM module provides real-time monitoring
            capabilities

            When disabled, stub implementation is compiled.
endmenu
```

## modules/Kconfig
```kconfig
menu "Modules"
config MODULES
	bool
	default y

config MODULES_DEBUG
        bool "Enable MODULUES DEBUG Features"
        default y
	help
	 Select y to enable debug symbols in modules,
	 say n to strip debug symbols

config ENCODER
        tristate "Enable Example Encoder Library"
        default n

config ECHO_CANCELLATION
        tristate "Enable ECHO Cancellation Library"
        default n

config EXAMPLE_GAIN
        tristate "Enable EXAMPLE_GAIN Library"
        default n

config CHMIXER
        tristate "Enable CHMIXER Library"
        default y

config MSIIR
        tristate "Enable MSIIR Library"
        default y

config PCM_CNV
        tristate "Enable PCM_CNV Library"
        select CH_MIXER
        select MSIIR
        default y

config GAIN
        tristate "Enable GAIN Library"
        default n

config SOFT_VOL
        tristate "Enable SOFT_VOL Library"
        default n

config FIR_FILTER
        tristate "Enable FIR_FILTER Library"
        default n

config POPLESS_EQUALIZER
        tristate "Enable POPLESS_EQUALIZER Library"
        default n

config SAL
        tristate "Enable SAL library"
        default n

endmenu
```

## west.yml
```yaml
# West manifest for AudioReach Engine Zephyr application
manifest:
  version: "0.13"

  defaults:
    remote: upstream
    revision: main

  remotes:
    - name: upstream
      url-base: https://github.com/zephyrproject-rtos

  projects:
    # Zephyr RTOS - pinned to specific revision
    - name: zephyr
      remote: upstream
      revision: 5eecc55398708d6944046a0379343fea1279c831
      path: zephyr
      west-commands: scripts/west-commands.yml
      import:
        name-allowlist:
          - cmsis
          - hal_xtensa
          - hal_nxp
          - mbedtls
          - mcuboot
          - tinycrypt
          - littlefs
          - libmetal
          - open-amp

  self:
    # This repository contains the AudioReach Engine application
    path: audioreach-engine
```
